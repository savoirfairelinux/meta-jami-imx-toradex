## conf/distro/jami-toradex-distro.conf
```bitbake
LICENSE = "GPL-3.0"

# Distro based on poky
require conf/distro/poky.conf

# Maintainer email
MAINTAINER = "support@savoirfairelinux.com"

# Distro description
DISTRO = "jami-toradex-distro"
DISTRO_NAME = "Jami Toradex distro"
DISTRO_VERSION = "1.0"

# Use systemd as default
DISTRO_FEATURES:append = " systemd"
VIRTUAL-RUNTIME_init_manager = "systemd"
VIRTUAL-RUNTIME_initscripts = "systemd-compat-units"

DISTRO_FEATURES_BACKFILL_CONSIDERED += "sysvinit"

# No need for x11 and wayland
DISTRO_FEATURES:remove = " x11"
DISTRO_FEATURES:remove = " wayland"
DISTRO_FEATURES:remove = " vulkan"

# Active buildhistory
INHERIT += "buildhistory"
BUILDHISTORY_COMMIT = "1"

# Active versioning
INHERIT += "image-buildinfo"
```

## conf/layer.conf
```bitbake
# We have a conf and classes directory, add to BBPATH
BBPATH .= ":${LAYERDIR}"

# We have recipes-* directories, add to BBFILES
BBFILES += "${LAYERDIR}/recipes-*/*/*.bb \
        ${LAYERDIR}/recipes-*/*/*.bbappend"

BBFILE_COLLECTIONS += "jami-imx-toradex"
BBFILE_PATTERN_jami-imx-toradex = "^${LAYERDIR}/"
BBFILE_PRIORITY_jami-imx-toradex = "6"

LAYERSERIES_COMPAT_jami-imx-toradex = "kirkstone"
LAYERDEPENDS_jami-imx-toradex = "core freescale-layer toradex-nxp-layer"

PREFERRED_VERSION_linux-toradex = "4.14.159+gitAUTOINC+1f43bce17a+gitAUTOINC+1f43bce17a"
PREFERRED_VERSION_kernel-module-imx-gpu-viv = "6.4.3.p2.4"
PREFERRED_PROVIDER_u-boot-default-script = "u-boot-script-toradex"
```

## conf/machine/apalis-imx6-toradex-kernel.conf
```bitbake
LICENSE = "GPL-3.0-only"

MACHINEOVERRIDES =. "apalis-imx6:"

IMX_DEFAULT_BSP = "nxp"

require conf/machine/apalis-imx6.conf
```
